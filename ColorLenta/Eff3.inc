	; прямое задание цветов
	; пиксель 1
	LDI R20, 255			; синий цвет                
	LDI R21, 255 		    ; красный цвет          
	LDI R22, 255		; зелёный цвет
	PUSH R20			; сохраняем синий цвет                
	PUSH R21			; сохраняем красный цвет          
	PUSH R22			; сохраняем зелёный цвет

; пиксель 2
	LDI R20, 0			; синий цвет                
	LDI R21, 80		; красный цвет          
	LDI R22, 0			; зелёный цвет
	PUSH R20			; сохраняем синий цвет                
	PUSH R21			; сохраняем красный цвет          
	PUSH R22			; сохраняем зелёный цвет

		; пиксель 3
	LDI R20, 255			; синий цвет                
	LDI R21, 255 		    ; красный цвет          
	LDI R22, 255		; зелёный цвет
	PUSH R20			; сохраняем синий цвет                
	PUSH R21			; сохраняем красный цвет          
	PUSH R22			; сохраняем зелёный цвет

	; пиксель 4
	LDI R20, 0			; синий цвет                
	LDI R21, 125		; красный цвет          
	LDI R22, 0			; зелёный цвет
	PUSH R20			; сохраняем синий цвет                
	PUSH R21			; сохраняем красный цвет          
	PUSH R22			; сохраняем зелёный цвет

		; пиксель 5
	LDI R20, 255			; синий цвет                
	LDI R21, 255 		    ; красный цвет          
	LDI R22, 255		; зелёный цвет
	PUSH R20			; сохраняем синий цвет                
	PUSH R21			; сохраняем красный цвет          
	PUSH R22			; сохраняем зелёный цвет
	
	; пиксель 6
	LDI R20, 0			; синий цвет                
	LDI R21, 255		; красный цвет          
	LDI R22, 0			; зелёный цвет
	PUSH R20			; сохраняем синий цвет                
	PUSH R21			; сохраняем красный цвет          
	PUSH R22			; сохраняем зелёный цвет

		; пиксель 7
	LDI R20, 255			; синий цвет                
	LDI R21, 255 		    ; красный цвет          
	LDI R22, 255		; зелёный цвет
	PUSH R20			; сохраняем синий цвет                
	PUSH R21			; сохраняем красный цвет          
	PUSH R22			; сохраняем зелёный цвет

	; пиксель 8
	LDI R20, 0			; синий цвет                
	LDI R21, 255		; красный цвет          
	LDI R22, 80			; зелёный цвет
	PUSH R20			; сохраняем синий цвет                
	PUSH R21			; сохраняем красный цвет          
	PUSH R22			; сохраняем зелёный цвет

		; пиксель 9
	LDI R20, 255			; синий цвет                
	LDI R21, 255 		    ; красный цвет          
	LDI R22, 255		; зелёный цвет
	PUSH R20			; сохраняем синий цвет                
	PUSH R21			; сохраняем красный цвет          
	PUSH R22			; сохраняем зелёный цвет

	; пиксель 10
	LDI R20, 0			; синий цвет                
	LDI R21, 125		; красный цвет          
	LDI R22, 125		; зелёный цвет
	PUSH R20			; сохраняем синий цвет                
	PUSH R21			; сохраняем красный цвет          
	PUSH R22			; сохраняем зелёный цвет

		; пиксель 11
	LDI R20, 255			; синий цвет                
	LDI R21, 255 		    ; красный цвет          
	LDI R22, 255		; зелёный цвет
	PUSH R20			; сохраняем синий цвет                
	PUSH R21			; сохраняем красный цвет          
	PUSH R22			; сохраняем зелёный цвет

		; пиксель 12
	LDI R20, 0			; синий цвет                
	LDI R21, 255		; красный цвет          
	LDI R22, 0			; зелёный цвет
	PUSH R20			; сохраняем синий цвет                
	PUSH R21			; сохраняем красный цвет          
	PUSH R22			; сохраняем зелёный цвет

		; пиксель 13
	LDI R20, 255			; синий цвет                
	LDI R21, 255 		    ; красный цвет          
	LDI R22, 255		; зелёный цвет
	PUSH R20			; сохраняем синий цвет                
	PUSH R21			; сохраняем красный цвет          
	PUSH R22			; сохраняем зелёный цвет

	; пиксель 14
	LDI R20, 0			; синий цвет                
	LDI R21, 255		; красный цвет          
	LDI R22, 80			; зелёный цвет
	PUSH R20			; сохраняем синий цвет                
	PUSH R21			; сохраняем красный цвет          
	PUSH R22			; сохраняем зелёный цвет

		; пиксель 15
	LDI R20, 255			; синий цвет                
	LDI R21, 255 		    ; красный цвет          
	LDI R22, 255		; зелёный цвет
	PUSH R20			; сохраняем синий цвет                
	PUSH R21			; сохраняем красный цвет          
	PUSH R22			; сохраняем зелёный цвет

	; пиксель 16
	LDI R20, 0			; синий цвет                
	LDI R21, 125		; красный цвет          
	LDI R22, 255		; зелёный цвет
	PUSH R20			; сохраняем синий цвет                
	PUSH R21			; сохраняем красный цвет          
	PUSH R22			; сохраняем зелёный цвет

	; пиксель 17
	LDI R20, 0			; синий цвет                
	LDI R21, 80 		; красный цвет          
	LDI R22, 255		; зелёный цвет
	PUSH R20			; сохраняем синий цвет                
	PUSH R21			; сохраняем красный цвет          
	PUSH R22			; сохраняем зелёный цвет

	; пиксель 18
	LDI R20, 0			; синий цвет                
	LDI R21, 0 		; красный цвет          
	LDI R22, 255		; зелёный цвет
	PUSH R20			; сохраняем синий цвет                
	PUSH R21			; сохраняем красный цвет          
	PUSH R22			; сохраняем зелёный цвет

	; пиксель 19
	LDI R20, 0			; синий цвет                
	LDI R21, 0 		    ; красный цвет          
	LDI R22, 125		; зелёный цвет
	PUSH R20			; сохраняем синий цвет                
	PUSH R21			; сохраняем красный цвет          
	PUSH R22			; сохраняем зелёный цвет

	; пиксель 20
	LDI R20, 0			; синий цвет                
	LDI R21, 0 		    ; красный цвет          
	LDI R22, 80 		; зелёный цвет
	PUSH R20			; сохраняем синий цвет                
	PUSH R21			; сохраняем красный цвет          
	PUSH R22			; сохраняем зелёный цвет

	; пиксель 21
	LDI R20, 80			; синий цвет                
	LDI R21, 0 		    ; красный цвет          
	LDI R22, 125 		; зелёный цвет
	PUSH R20			; сохраняем синий цвет                
	PUSH R21			; сохраняем красный цвет          
	PUSH R22			; сохраняем зелёный цвет

	; пиксель 22
	LDI R20, 125			; синий цвет                
	LDI R21, 0 		    ; красный цвет          
	LDI R22, 125 		; зелёный цвет
	PUSH R20			; сохраняем синий цвет                
	PUSH R21			; сохраняем красный цвет          
	PUSH R22			; сохраняем зелёный цвет

	; пиксель 23
	LDI R20, 255			; синий цвет                
	LDI R21, 0 		    ; красный цвет          
	LDI R22, 125 		; зелёный цвет
	PUSH R20			; сохраняем синий цвет                
	PUSH R21			; сохраняем красный цвет          
	PUSH R22			; сохраняем зелёный цвет

	; пиксель 24
	LDI R20, 255			; синий цвет                
	LDI R21, 125 		    ; красный цвет          
	LDI R22, 0 		; зелёный цвет
	PUSH R20			; сохраняем синий цвет                
	PUSH R21			; сохраняем красный цвет          
	PUSH R22			; сохраняем зелёный цвет

	; пиксель 25
	LDI R20, 125			; синий цвет                
	LDI R21, 125 		    ; красный цвет          
	LDI R22, 0 		; зелёный цвет
	PUSH R20			; сохраняем синий цвет                
	PUSH R21			; сохраняем красный цвет          
	PUSH R22			; сохраняем зелёный цвет

	; пиксель 26
	LDI R20, 80			; синий цвет                
	LDI R21, 125 		    ; красный цвет          
	LDI R22, 0 		; зелёный цвет
	PUSH R20			; сохраняем синий цвет                
	PUSH R21			; сохраняем красный цвет          
	PUSH R22			; сохраняем зелёный цвет

		; пиксель 27
	LDI R20, 80			; синий цвет                
	LDI R21, 255 		    ; красный цвет          
	LDI R22, 50 		; зелёный цвет
	PUSH R20			; сохраняем синий цвет                
	PUSH R21			; сохраняем красный цвет          
	PUSH R22			; сохраняем зелёный цвет

	; пиксель 28
	LDI R20, 255			; синий цвет                
	LDI R21, 139		    ; красный цвет          
	LDI R22, 0		; зелёный цвет
	PUSH R20			; сохраняем синий цвет                
	PUSH R21			; сохраняем красный цвет          
	PUSH R22			; сохраняем зелёный цвет

		; пиксель 29
	LDI R20, 255			; синий цвет                
	LDI R21, 139		    ; красный цвет          
	LDI R22, 0		; зелёный цвет
	PUSH R20			; сохраняем синий цвет                
	PUSH R21			; сохраняем красный цвет          
	PUSH R22			; сохраняем зелёный цвет

		; пиксель 30
	LDI R20, 255			; синий цвет                
	LDI R21, 139		    ; красный цвет          
	LDI R22, 0		; зелёный цвет
	PUSH R20			; сохраняем синий цвет                
	PUSH R21			; сохраняем красный цвет          
	PUSH R22			; сохраняем зелёный цвет