	;---------------------------  ФОРМИРОВАНИЕ МАССИВА ЦВЕТОВ (массива пиксельных байтов) -----------------------------------------------	
    ; Цвет фона
UpdateArrayLed:
	mov R19, CountLED       ; количество груп байтов
	clr  r29       ;Очистить старший байт Y
    ldi  r28, $60  ;Установить адрес первого байта в младший байт Y
ArrayLed:      
	ST Y+, Green  ; зелёный цвет
	ST Y+, Red	; красный цвет
	ST Y+, Blue	; синий цвет
	DEC R19
	BRNE ArrayLed
	
	RET
	;----------------------------------------------------------------------------

; ВКЛЮЧЕНИЕ СВЕТОДИОДОВ. Назначение регистров:
; R18 - текущий байт извлёченый из массива и выводимый на ленту
; R19 - счётчик байтов извлекаемых из массива
; R20 - счётчик битов текущего байта
; R21 - байт для хранения бита 1 выводимого командой out
; R22 - байт для хранения бита 0 выводимого командой out (out выполняется за один цикл - экономим время)
ShowLED:
	LDI R19, 0				; обнуляем счётчик байтов 
	ADD R19, CountLED       ; счётчик байтов = счётчик байтов + количество груп байтов
	ADD R19, CountLED       ; и так три раза...
	ADD R19, CountLED       
	DEC R19					; первый байт загружаем до входа в цикл, поэтому вычитаем единицу из счётчика до входа в цикл

	LDI R20, 8	  ; счётчик битов от 7 до 0
	mov R1,R20    
	LDI R21, 0x02 ;
	LDI R22, 0x00 ;


	clr  r29        ;Помещаем в регистровую пару Y ...
    ldi  r28, $60   ;адрес первого байта массива цветов
	LD R18, Y+      ;  первый байт для вывода на ленту
	CLZ             ; сброс флага нуля 
start:
	OUT PORTD, R21
	nop
	nop
	LSR R18
	BRSH zerro

	DEC R20
	BREQ NewByte1
	SBI PORTD, 6 ;  Зажеч индикаторный светодиод установить бит 
	CBI PORTD, 7 ;  погасить индикатор
	nop
	nop
	;nop
	;nop
EndNewByte1:	

zerro: 
	OUT PORTD, R22
	nop
   	BRLO one
	
	DEC R20
	BREQ NewByte2
	SBI PORTD, 6 ;  Зажеч индикаторный светодиод установить бит 
	CBI PORTD, 7 ;  погасить индикатор 
	nop	
	nop
EndNewByte2:	
one:
	rjmp start

NewByte1:
	LD R18, Y+   		; загрузка следующего байта
	mov R20,R1
	DEC R19
	BREQ EndShowLed
	rjmp EndNewByte1

NewByte2:
	LD R18, Y+        ; загрузка следующего байта
	mov R20,R1
	DEC R19
	BREQ EndShowLed
	rjmp EndNewByte2

EndShowLed:
	CBI PORTD, 1        ; сбросить бит D1, пауза между посылками на светодиодную ленту
	RET
